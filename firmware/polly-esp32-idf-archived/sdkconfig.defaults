## firmware/polly-esp32-idf-archived/sdkconfig.defaults
```kconfig
# ESP32-S3 Configuration
CONFIG_IDF_TARGET="esp32s3"
CONFIG_ESPTOOLPY_FLASHSIZE_8MB=y

# PSRAM (required for Porcupine)
CONFIG_SPIRAM=y
CONFIG_SPIRAM_MODE_QUAD=y
CONFIG_SPIRAM_TYPE_AUTO=y
CONFIG_SPIRAM_SIZE=8388608
CONFIG_SPIRAM_USE_MALLOC=y
CONFIG_SPIRAM_MALLOC_ALWAYSINTERNAL=16384

# WiFi
CONFIG_ESP_WIFI_STATIC_RX_BUFFER_NUM=8
CONFIG_ESP_WIFI_DYNAMIC_RX_BUFFER_NUM=16
CONFIG_ESP_WIFI_TX_BUFFER_TYPE=1
CONFIG_ESP_WIFI_DYNAMIC_TX_BUFFER_NUM=16

# TCP/IP
CONFIG_LWIP_MAX_SOCKETS=10
CONFIG_LWIP_SO_RCVBUF=y
CONFIG_LWIP_TCP_SND_BUF_DEFAULT=5744
CONFIG_LWIP_TCP_WND_DEFAULT=5744
CONFIG_LWIP_TCP_RECVMBOX_SIZE=12
CONFIG_LWIP_UDP_RECVMBOX_SIZE=12
CONFIG_LWIP_TCPIP_RECVMBOX_SIZE=32

# Logging
CONFIG_LOG_DEFAULT_LEVEL_INFO=y

# FreeRTOS
CONFIG_FREERTOS_HZ=1000
CONFIG_FREERTOS_UNICORE=n

# I2S
CONFIG_I2S_ENABLE_DEBUG_LOG=n

# WebSocket
CONFIG_WS_BUFFER_SIZE=2048
CONFIG_WS_TRANSPORT_UNKNOWN_OPCODE_AS_TEXT=y
```

## firmware/polly-esp32/main/Kconfig.projbuild
```kconfig
menu "Polly ESP32 Configuration"

config WIFI_SSID
    string "WiFi SSID"
    default "myssid"
    help
        SSID (network name) for the ESP32 to connect to.

config WIFI_PASSWORD
    string "WiFi Password"
    default "mypassword"
    help
        WiFi password (WPA or WPA2) for the ESP32 to use.

config WIFI_MAXIMUM_RETRY
    int "Maximum retry"
    default 5
    help
        Set the Maximum retry to avoid station reconnecting to the AP unlimited.

config SERVER_URI
    string "Server WebSocket URI"
    default "ws://192.168.1.100:8000/api/audio/stream"
    help
        WebSocket URI of the Polly Connect server.

config PORCUPINE_ACCESS_KEY
    string "Picovoice Access Key"
    default "YOUR_ACCESS_KEY_HERE"
    help
        Access key from Picovoice Console (https://console.picovoice.ai/).

config PORCUPINE_SENSITIVITY
    string "Wake word sensitivity (0.0-1.0)"
    default "0.5"
    help
        Sensitivity for wake word detection. Higher = more sensitive but more false positives.

config AUDIO_BUFFER_SECONDS
    int "Pre-wake audio buffer (seconds)"
    default 2
    range 1 10
    help
        Seconds of audio to buffer before wake word for context.

endmenu
```

## firmware/polly-s3-wakeword/sdkconfig.defaults
```kconfig
# ESP32-S3-WROOM-1-N16R8 specific config

# Target
CONFIG_IDF_TARGET="esp32s3"

# Flash - 16MB
CONFIG_ESPTOOLPY_FLASHSIZE_16MB=y
CONFIG_PARTITION_TABLE_CUSTOM=y
CONFIG_PARTITION_TABLE_CUSTOM_FILENAME="partitions.csv"

# PSRAM - 8MB Octal
CONFIG_SPIRAM=y
CONFIG_SPIRAM_MODE_OCT=y
CONFIG_SPIRAM_SPEED_80M=y
CONFIG_SPIRAM_BOOT_INIT=y
CONFIG_SPIRAM_ALLOW_STACK_EXTERNAL_MEMORY=y

# WiFi
CONFIG_ESP_WIFI_SOFTAP_SUPPORT=y

# Audio / I2S
CONFIG_I2S_ISR_IRAM_SAFE=y

# Performance
CONFIG_ESP_DEFAULT_CPU_FREQ_MHZ_240=y
CONFIG_FREERTOS_HZ=1000

# Stack size
CONFIG_ESP_MAIN_TASK_STACK_SIZE=8192
CONFIG_ESP_SYSTEM_EVENT_TASK_STACK_SIZE=4096
```

## firmware/polly-v2-bringup/sdkconfig.defaults
```kconfig
CONFIG_ESPTOOLPY_FLASHSIZE_16MB=y
CONFIG_ESPTOOLPY_FLASHSIZE="16MB"
CONFIG_FREERTOS_HZ=1000
# Route console (logs) over the native USB-Serial-JTAG so it shows on COM3
CONFIG_ESP_CONSOLE_USB_SERIAL_JTAG=y
```
